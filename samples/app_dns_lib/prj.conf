## CMakeLists.txt
```
cmake_minimum_required(VERSION 3.20.0)
find_package(Zephyr REQUIRED HINTS $ENV{ZEPHYR_BASE})
project(app_dns_lib_basic)

target_sources(app PRIVATE src/main.c)
```

## prj.conf
```kconfig
CONFIG_APP_DNS_LIB=y
CONFIG_LOG=y
CONFIG_LOG_DEFAULT_LEVEL=3
```

## src/main.c
```c
#include <app_dns_lib/app_dns_lib.h>
#include <zephyr/kernel.h>

int main(void) {
  app_dns_lib_init();

  // int result = app_dns_lib_do_something(21);
  // printk("Result = %d\n", result);

  while (1) {
    k_sleep(K_SECONDS(1));
  }
}
```
